## app/example/bluetooth/provisioner/Config.in
```kconfig
menuconfig AOS_APP_BLEMESH_PROVISIONER
    bool "blemesh_provisioner"
    select AOS_COMP_BT_MESH_PROFILE
    select AOS_COMP_BT
    select AOS_COMP_CLI
    select AOS_COMP_YLOOP
    help

if AOS_APP_BLEMESH_PROVISIONER
# Configurations for app blemesh_provisioner
endif
```

## network/bluetooth/bt_dfu/Config.in
```kconfig
menuconfig AOS_COMP_BTDFU
    bool "bt_dfu"
    default n
    select AOS_COMP_CONTROLLER if @CONDITION@
    select AOS_COMP_YLOOP
    help

if AOS_COMP_BTDFU
# Configurations for comp bt
endif
```
